/ {
    aliases {
        my-led = &led;
        my-button = &user_button;
    };

    leds {
			compatible = "gpio-leds";
			led: led {
					gpios = <&gpiob 2 GPIO_ACTIVE_HIGH>;
					label = "User LED";
			};
        };
};